/*********************************************************************************************
模板制作：  杜洋工作室/洋桃电子
程序名：	按键控制LED程序
编写人：	杜洋	
编写时间：	2017年12月29日
硬件支持：	STM32F103C8   外部晶振8MHz RCC函数设置主频72MHz　  

修改日志：　　
1-	
	
							
说明：
 # 本模板加载了STM32F103内部的RCC时钟设置，并加入了利用滴答定时器的延时函数。
 # 可根据自己的需要增加或删减。

*********************************************************************************************/
#include "stm32f10x.h" //STM32头文件

#include "sys.h"
#include "delay.h"
#include "usart.h"

#include "string.h"

#include "ttp229.h"

extern u8 INT_MARK;//中断标志位

int main (void){//主程序
  
	u8 a=0; //定义变量
  
	//初始化程序
  delay_ms(500);
  
	RCC_Configuration(); //时钟设置
  
	uart_init(115200); //串口初始化，参数中写波特率
  
  INT_MARK=0;//标志位清0
  
	NVIC_Configuration();//设置中断优先级
  
  TTP229_Init();//ttp229引脚初始化
  
  ttp229_INT_INIT();//ttp229引脚中断初始化

	//主循环
	while(1){
    
    if(INT_MARK){
    
      INT_MARK=0;
      
      a=ttp229_read();
      
      if(a!=0){
    
        printf("key_0:%d\r\n",a);
      }
    }
	}
}


/*********************************************************************************************
 * 杜洋工作室 www.DoYoung.net
 * 洋桃电子 www.DoYoung.net/YT 
*********************************************************************************************/
/*

【变量定义】
u32     a; //定义32位无符号变量a
u16     a; //定义16位无符号变量a
u8     a; //定义8位无符号变量a
vu32     a; //定义易变的32位无符号变量a
vu16     a; //定义易变的 16位无符号变量a
vu8     a; //定义易变的 8位无符号变量a
uc32     a; //定义只读的32位无符号变量a
uc16     a; //定义只读 的16位无符号变量a
uc8     a; //定义只读 的8位无符号变量a

#define ONE  1   //宏定义

delay_us(1); //延时1微秒
delay_ms(1); //延时1毫秒
delay_s(1); //延时1秒

*/



