`timescale 1ns/1ps
// Generated by tools/generate_hc05_decoder.py. One comparator and one ROM
// serve every command; only the final four argument bytes stay in flops.
// The caller supplies a synchronous command-RAM byte at position.
// Template bytes live in src/hc05_command.hex because a generate loop over
// every ROM address exceeds the synthesis loop-count limit.
module hc05_command_decode(
    input wire clk,resetn,start,
    input wire [6:0] line_length,
    input wire [7:0] character,
    output reg [5:0] position,
    output reg done,
    output reg [5:0] command
);
    localparam integer COMMAND_COUNT=63, ROM_BYTES=COMMAND_COUNT*32;
    localparam [2:0] IDLE=0,HEADER_WAIT=1,HEADER=2,LENGTH_WAIT=3,
        LENGTH=4,CHAR_WAIT=5,CHARACTER=6;
    (* syn_ramstyle="block_ram" *) reg [7:0] dictionary [0:ROM_BYTES-1];
    initial $readmemh("src/hc05_command.hex", dictionary);
    reg [10:0] rom_address;
    reg [7:0] rom_q;
    always @(posedge clk)rom_q<=dictionary[rom_address];
    reg [2:0] state;
    reg [5:0] template_index;
    wire [5:0] next_template=template_index+6'd1;
    wire [5:0] matched_command=template_index==6'd60 ? 6'd62 : template_index==6'd61 ? 6'd61 : template_index+6'd1;
    reg [4:0] pattern_length;
    reg [6:0] saved_length;
    task advance;
        begin
            if(template_index==COMMAND_COUNT-1)begin
                command<=0;done<=1;state<=IDLE;
            end else begin
                template_index<=next_template;
                rom_address<={next_template,5'd0};state<=HEADER_WAIT;
            end
        end
    endtask
    always @(posedge clk)begin
        if(!resetn)begin
            state<=IDLE;template_index<=0;rom_address<=0;position<=0;
            saved_length<=0;pattern_length<=0;command<=0;done<=0;
        end else begin
            done<=0;
            case(state)
                IDLE:if(start)begin
                    saved_length<=line_length;template_index<=0;rom_address<=0;
                    command<=0;position<=0;state<=HEADER_WAIT;
                end
                HEADER_WAIT:state<=HEADER;
                HEADER:if(rom_q[7] ? saved_length>rom_q[6:0] : saved_length==rom_q[6:0])begin
                    rom_address<=rom_address+11'd1;state<=LENGTH_WAIT;
                end else advance;
                LENGTH_WAIT:state<=LENGTH;
                LENGTH:begin
                    pattern_length<=rom_q[4:0];position<=0;
                    rom_address<=rom_address+11'd1;state<=CHAR_WAIT;
                end
                CHAR_WAIT:state<=CHARACTER;
                CHARACTER:if(character!=rom_q)advance;
                    else if(position=={1'b0,pattern_length}-6'd1)begin
                        command<=matched_command;done<=1;state<=IDLE;
                    end else begin
                        position<=position+6'd1;rom_address<=rom_address+11'd1;
                        state<=CHAR_WAIT;
                    end
                default:state<=IDLE;
            endcase
        end
    end
endmodule
